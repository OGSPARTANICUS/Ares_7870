## arch/arm64/configs/exynos7870-ares_defconfig
```kconfig
#
#
# AresKernel
#
CONFIG_STORE_MODE=y
CONFIG_ASMP=y
# CONFIG_HOTPLUG_CPU is not set
# CONFIG_EXYNOS_HOTPLUG_GOVERNOR is not set
CONFIG_CPU_THERMAL_IPA_CONTROL=y
CONFIG_CPU_THERMAL_IPA=y
CONFIG_NR_CPUS=8
CONFIG_NR_CLUSTERS=2
CONFIG_SCHED_HMP=y
# CONFIG_SCHED_HMP_PRIO_FILTER is not set
CONFIG_HMP_FREQUENCY_INVARIANT_SCALE=y
# CONFIG_SCHED_HMP_LITTLE_PACKING is not set
CONFIG_DISABLE_CPU_SCHED_DOMAIN_BALANCE=y
CONFIG_HMP_FAST_CPU_MASK="4-7"
CONFIG_HMP_SLOW_CPU_MASK="0-3"
CONFIG_HMP_VARIABLE_SCALE=y
CONFIG_HMP_FREQUENCY_INVARIANT_SCALE=y
CONFIG_QUICK_WAKEUP=y
CONFIG_FRANDOM=y
CONFIG_IOSCHED_SIO=y
CONFIG_IOSCHED_FIOPS=y
# CONFIG_CPU_FREQ_DEFAULT_GOV_BLU_ACTIVE is not set
# CONFIG_CPU_FREQ_DEFAULT_GOV_ONDEMANDPLUS is not set
# CONFIG_CPU_FREQ_DEFAULT_GOV_ONDEMAND is not set
CONFIG_CPU_FREQ_GOV_BLU_ACTIVE=y
CONFIG_CPU_FREQ_GOV_ONDEMANDPLUS=y
CONFIG_CPU_FREQ_GOV_ONDEMAND=y
# CONFIG_MALI_R12P0 is not set
# CONFIG_MALI_R15P0 is not set
# CONFIG_MALI_R21P0 is not set
# CONFIG_MALI_R22P0 is not set
# CONFIG_MALI_R28P0 is not set
CONFIG_MALI_R29P0=y
CONFIG_RD_BZIP2=y
CONFIG_RD_XZ=y
CONFIG_RD_LZO=y
CONFIG_RD_LZ4=y
CONFIG_CPUSETS=y
# CONFIG_HZ_100 is not set
CONFIG_HZ_250=y
# CONFIG_HZ_300 is not set
# CONFIG_HZ_1000 is not set
CONFIG_HZ=250
CONFIG_SCHED_HRTICK=y
CONFIG_ARCH_SUPPORTS_DEBUG_PAGEALLOC=y
CONFIG_ANDROID_TIMED_GPIO=y
CONFIG_MEDIA_TUNER=y
CONFIG_MEDIA_TUNER_SIMPLE=y
CONFIG_MEDIA_TUNER_TDA8290=y
CONFIG_MEDIA_TUNER_TDA827X=y
CONFIG_MEDIA_TUNER_TDA18271=y
CONFIG_MEDIA_TUNER_TDA9887=y
CONFIG_MEDIA_TUNER_TEA5761=y
CONFIG_MEDIA_TUNER_TEA5767=y
CONFIG_MEDIA_TUNER_MT20XX=y
CONFIG_MEDIA_TUNER_XC2028=y
CONFIG_MEDIA_TUNER_XC5000=y
CONFIG_MEDIA_TUNER_XC4000=y
CONFIG_MEDIA_TUNER_MC44S803=y
```
